## conf/layer.conf
```bitbake
# We have a conf and classes directory, add to BBPATH
BBPATH .= ":${LAYERDIR}"

# We have recipes-* directories, add to BBFILES
BBFILES += "${LAYERDIR}/recipes-*/*/*.bb \
            ${LAYERDIR}/recipes-*/*/*.bbappend"

BBFILE_COLLECTIONS += "impulse"
BBFILE_PATTERN_impulse = "^${LAYERDIR}/"
BBFILE_PRIORITY_impulse = "10"
LAYERVERSION_impulse = "0"

LAYERSERIES_COMPAT_impulse = "zeus"
```

## conf/machine/ecube.conf
```bitbake
#@TYPE: Machine
#@NAME: eCube machine
#@DESCRIPTION: Machine configuration for running eCube

SOC_FAMILY = "r8a77980"

# Specific WKS file to reduce size
WKS_FILE = "image-ecube.wks"

# V3x configuration
MACHINEOVERRIDES =. "condor:"
require conf/machine/include/v3x.inc

# Remove U-Boot
EXTRA_IMAGEDEPENDS_remove = " u-boot"
```
